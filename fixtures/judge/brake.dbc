VERSION ""

NS_ :

BS_:

BU_: ESC BCM

BO_ 256 BrakeCmd: 8 ESC
 SG_ BrakePedal : 0|8@1+ (1,0) [0|1] "" ESC

BO_ 512 Lamps: 8 BCM
 SG_ BrakeLamp : 0|1@1+ (1,0) [0|1] "" BCM

BA_DEF_ BO_ "GenMsgCycleTime" INT 0 3600000;
BA_ "GenMsgCycleTime" BO_ 256 10;
BA_ "GenMsgCycleTime" BO_ 512 10;
